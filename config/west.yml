## config/west.yml
```yaml
manifest:
  remotes:
    - name: zmkfirmware
      url-base: https://github.com/zmkfirmware
  projects:
    - name: zmk
      remote: zmkfirmware
      revision: main
          snippet: studio-rpc-usb-uart
      import: app/west.yml
  self:
    path: config
```
